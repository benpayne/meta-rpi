## conf/bblayers.conf
```bitbake
# POKY_BBLAYERS_CONF_VERSION is increased each time build/conf/bblayers.conf
# changes incompatibly
POKY_BBLAYERS_CONF_VERSION = "2"

BBPATH = "${TOPDIR}"
BBFILES ?= ""

BASE="/opt/yocto-rpi"

BBLAYERS ?= " \
    ${BASE}/poky/meta \
    ${BASE}/poky/meta-poky \
    ${BASE}/poky/meta-openembedded/meta-oe \
    ${BASE}/poky/meta-openembedded/meta-multimedia \
    ${BASE}/poky/meta-openembedded/meta-networking \
    ${BASE}/poky/meta-openembedded/meta-perl \
    ${BASE}/poky/meta-openembedded/meta-python \
    ${BASE}/poky/meta-qt5 \
    ${BASE}/poky/meta-raspberrypi \
    ${BASE}/poky/meta-security \
    ${BASE}/poky/meta-jumpnow \
    ${BASE}/meta-rpi \
"
```
